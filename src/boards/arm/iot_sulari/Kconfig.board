## src/boards/arm/iot_sulari/Kconfig.board
```kconfig
# Copyright (c) 2023 Nordic Semiconductor ASA
# SPDX-License-Identifier: Apache-2.0

config BOARD_IOT_SULARI
	bool "IoT-sulari"
	depends on SOC_NRF9160_SICA
```

## src/boards/arm/iot_sulari/Kconfig.defconfig
```kconfig
# Copyright (c) 2023 Nordic Semiconductor ASA
# SPDX-License-Identifier: Apache-2.0

if BOARD_IOT_SULARI

config BOARD
	default "iot_sulari"


endif
```

## src/boards/arm/iot_sulari/iot_sulari_defconfig
```kconfig
# Copyright (c) 2023 Nordic Semiconductor ASA
# SPDX-License-Identifier: Apache-2.0

CONFIG_SOC_SERIES_NRF91X=y
CONFIG_SOC_NRF9160_SICA=y
CONFIG_BOARD_IOT_SULARI=y

# Enable MPU
CONFIG_ARM_MPU=y

# Enable hardware stack protection
CONFIG_HW_STACK_PROTECTION=y

# Enable TrustZone-M
CONFIG_ARM_TRUSTZONE_M=y
CONFIG_BUILD_WITH_TFM=y

# This Board implies building Non-Secure firmware
CONFIG_TRUSTED_EXECUTION_NONSECURE=y

# Enable GPIO
CONFIG_GPIO=y

#Enable UART
CONFIG_SERIAL=y

# Enable console
CONFIG_CONSOLE=y
CONFIG_UART_CONSOLE=y

CONFIG_PINCTRL=y
```

## src/drivers/display/waveshare_epd_2in9_v2/Kconfig
```kconfig
# Waveshare EPD 2in9 V2 E-paper display module configuration options
# https://www.waveshare.com/wiki/2.9inch_e-Paper_Module

menuconfig WAVESHARE_EPD_2IN9_V2
    bool "Waveshare EPD 2in9 V2 E-paper display module"
    depends on (SPI && GPIO)
    help
        Enable SPI and GPIO based drivers for Waveshare EPD 2in9 V2 E-paper display module

module = EPD_2IN9_V2
module-str = EPD_2IN9_V2
source "${ZEPHYR_BASE}/subsys/logging/Kconfig.template.log_config"
```
